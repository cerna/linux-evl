## drivers/steely/Kconfig
```kconfig
menu "Drivers"

source "drivers/steely/autotune/Kconfig"
source "drivers/steely/ipc/Kconfig"
source "drivers/steely/testing/Kconfig"

endmenu
```

## drivers/steely/ipc/Kconfig
```kconfig
menu "Real-time IPC drivers"

config STEELY_RTIPC
	tristate "RTIPC protocol family"
	help

	This driver provides the real-time IPC protocol family
	(PF_RTIPC) over RTDM.

config STEELY_RTIPC_XDDP
	depends on STEELY_RTIPC
	select STEELY_PIPE
	default y
	bool "XDDP cross-domain datagram protocol"
	help

	Steely's XDDP protocol enables threads to exchange datagrams
	across the main kernel <-> steely core boundary, using
	"message pipes".

	Message pipes are bi-directional FIFO communication channels
	allowing data exchange between real-time Steely threads and
	regular (i.e. non real-time) user-space processes. Message
	pipes are datagram-based and thus natively preserve message
	boundaries, but they can also be used in byte stream mode when
	sending from the real-time to the non real-time domain.

	The maximum number of communication ports available in the
	system can be configured using the STEELY_PIPE_NRDEV option
	from the Nucleus menu.

config STEELY_RTIPC_IDDP
	depends on STEELY_RTIPC
	select STEELY_MAP
	default y
	bool "IDDP intra-domain datagram protocol"
	help

	Steely's IDDP protocol enables real-time threads to exchange
	datagrams within the Steely domain.

config STEELY_IDDP_NRPORT
	depends on STEELY_RTIPC_IDDP
	int "Number of IDDP communication ports"
	default 32
	help

	This parameter defines the number of IDDP ports available in
	the system for creating receiver endpoints. Port numbers range
	from 0 to CONFIG_STEELY_IDDP_NRPORT - 1.

config STEELY_RTIPC_BUFP
	depends on STEELY_RTIPC
	select STEELY_MAP
	default y
	bool "Buffer protocol"
	help

	The buffer protocol implements a byte-oriented, one-way
	Producer-Consumer data path, which makes it a bit faster than
	datagram-oriented protocols. All messages written are buffered
	into a single memory area in strict FIFO order, until read by
	the consumer.

	This protocol prevents short writes, and only allows short
	reads when a potential deadlock situation arises (i.e. readers
	and writers waiting for each other indefinitely), which
	usually means that the buffer size does not fit the use peer
	threads are making from the protocol.

config STEELY_BUFP_NRPORT
	depends on STEELY_RTIPC_BUFP
	int "Number of BUFP communication ports"
	default 32
	help

	This parameter defines the number of BUFP ports available in
	the system for creating receiver endpoints. Port numbers range
	from 0 to CONFIG_STEELY_BUFP_NRPORT - 1.

endmenu
```

## drivers/steely/testing/Kconfig
```kconfig
menu "Testing drivers"

config STEELY_TIMERBENCH
	tristate "Timer benchmark driver"
	default y
	help
	Kernel-based benchmark driver for timer latency evaluation.
	See testsuite/latency for a possible front-end.

config STEELY_SWITCHTEST
	tristate "Context switch unit testing driver"
	default y
	help
	Kernel-based driver for unit testing context switches and
	FPU switches.

config STEELY_RTDMTEST
	depends on m
	tristate "RTDM unit tests driver"
	help
	Kernel driver for performing RTDM unit tests.

endmenu
```

## kernel/Kconfig.steely
```kconfig
# Steely real-time co-kernel
config HAVE_ARCH_STEELY
	bool

menuconfig STEELY
	bool "Enable the Steely core"
	depends on HAVE_ARCH_STEELY
	select DOVETAIL
	help
	  Xenomai's Steely core is a real-time extension to the Linux
	  kernel, which exhibits very short interrupt and scheduling
	  latency, without affecting the regular kernel services.

	  This option enables the set of extended kernel services
	  required to run the real-time applications in user-space.

	  Please visit http://xenomai.org for more information.

if STEELY

source "kernel/steely/Kconfig"
source "drivers/steely/Kconfig"

config STEELY_ARCH_SYS3264
        def_bool n

config STEELY_ARCH_OUTOFLINE_XNLOCK
       bool
       default y

if MIGRATION
comment "WARNING! Page migration (CONFIG_MIGRATION) may increase"
comment "latency."
endif

config VERSION_MAJOR
       int
       default 0

config VERSION_MINOR
       int
       default 0

config REVISION_LEVEL
       int
       default 1

config VERSION_STRING
       string
       default none

config VERSION_NAME
       string
       default none

endif
```
